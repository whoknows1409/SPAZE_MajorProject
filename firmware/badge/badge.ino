/*
 * SPAZE Badge Firmware v2.0 (PAKL)
 * ESP32-WROOM-32 BLE Advertiser
 *
 * Broadcasts a rolling presence token in BLE manufacturer data:
 *   [0xFF 0xFF][0x5A][ver=0x01][badge_id:4][counter:4][tag:8]
 *   tag = HMAC-SHA256(BADGE_KEY, 0x5A || ver || badge_id || counter)[:8]
 *
 * The counter is (boot_epoch << 20) | seconds_since_boot and changes every
 * second. boot_epoch is persisted in NVS so the counter never goes backwards
 * across reboots. The server verifies the tag and rejects stale counters, so
 * copying the badge MAC or replaying an old broadcast does not unlock a vault.
 *
 * PAKL-CR: the badge also exposes a GATT characteristic. The anchor writes a
 * 16-byte server challenge; the badge answers with
 *   HMAC-SHA256(BADGE_KEY, "CR" || challenge)[:8]
 * by notification, and the anchor measures the round-trip time. A relay adds
 * latency to this exchange, which the server bounds.
 *
 * BADGE_ID and BADGE_KEY come from badge_secrets.h, generated by
 *   python scripts/provision_pakl.py
 */

#include <BLEDevice.h>
#include <BLEUtils.h>
#include <BLEAdvertising.h>
#include <BLEServer.h>
#include <BLE2902.h>
#include <Preferences.h>
#include "mbedtls/md.h"

#if __has_include("badge_secrets.h")
#include "badge_secrets.h"
#else
#error "badge_secrets.h missing - run: python scripts/provision_pakl.py"
#endif

// ===== Configuration =====
#ifndef LED_BUILTIN
#define LED_BUILTIN 2   // GPIO 2 = built-in LED on most ESP32 DevKits
#endif
#define DEVICE_NAME         "SZ-BADGE-001"

// Advertising interval in 0.625 ms units: 0x00A0 = 100 ms
#define ADV_INTERVAL        0x00A0

#define TOKEN_MAGIC         0x5A
#define TOKEN_VERSION       0x01
#define TOKEN_LEN           20
#define SECS_BITS           20      // seconds field; epoch rolls after ~12 days
#define TOKEN_PERIOD_MS     1000

// PAKL-CR challenge-response service
#define CR_SERVICE_UUID     "4fafc201-1fb5-459e-8fcc-c5c9c331914b"
#define CR_CHAR_UUID        "beb5483e-36e1-4688-b7f5-ea07361b26a8"
#define CR_NONCE_LEN        16

// EXPERIMENT ONLY: honour a delay byte appended to the challenge so that relay
// latency can be emulated. Set to 0 for any real deployment.
#define RELAY_EMULATION     1

// ===== Globals =====
BLEAdvertising *pAdvertising;
BLECharacteristic *pCrChar;
Preferences prefs;
uint32_t bootEpoch = 0;
uint32_t epochBaseMs = 0;
uint32_t lastCounter = 0xFFFFFFFF;
uint32_t lastBlinkMs = 0;
uint32_t lastStatusMs = 0;

uint32_t nextEpoch() {
    prefs.begin("spaze", false);
    uint32_t e = prefs.getUInt("epoch", 0) + 1;
    prefs.putUInt("epoch", e);
    prefs.end();
    return e;
}

uint32_t currentCounter() {
    uint32_t secs = (millis() - epochBaseMs) / 1000;
    if (secs >= (1UL << SECS_BITS)) {
        // Long uptime: start a new epoch so the counter keeps increasing
        bootEpoch = nextEpoch();
        epochBaseMs = millis();
        secs = 0;
    }
    return (bootEpoch << SECS_BITS) | secs;
}

void buildToken(uint32_t counter, uint8_t out[TOKEN_LEN]) {
    out[0] = 0xFF;                       // company ID 0xFFFF (testing)
    out[1] = 0xFF;
    out[2] = TOKEN_MAGIC;
    out[3] = TOKEN_VERSION;
    out[4] = (BADGE_ID >> 24) & 0xFF;
    out[5] = (BADGE_ID >> 16) & 0xFF;
    out[6] = (BADGE_ID >> 8) & 0xFF;
    out[7] = BADGE_ID & 0xFF;
    out[8] = (counter >> 24) & 0xFF;
    out[9] = (counter >> 16) & 0xFF;
    out[10] = (counter >> 8) & 0xFF;
    out[11] = counter & 0xFF;

    uint8_t mac[32];
    mbedtls_md_hmac(mbedtls_md_info_from_type(MBEDTLS_MD_SHA256),
                    BADGE_KEY, sizeof(BADGE_KEY),
                    out + 2, 10, mac);
    memcpy(out + 12, mac, 8);
}

class CrCallbacks : public BLECharacteristicCallbacks {
    void onWrite(BLECharacteristic *c) {
        size_t len = c->getLength();
        if (len < CR_NONCE_LEN) return;
        const uint8_t *in = c->getData();
        uint8_t msg[2 + CR_NONCE_LEN];
        msg[0] = 'C';
        msg[1] = 'R';
        memcpy(msg + 2, in, CR_NONCE_LEN);
        uint8_t mac[32];
        mbedtls_md_hmac(mbedtls_md_info_from_type(MBEDTLS_MD_SHA256),
                        BADGE_KEY, sizeof(BADGE_KEY), msg, sizeof(msg), mac);
#if RELAY_EMULATION
        if (len > CR_NONCE_LEN && in[CR_NONCE_LEN] > 0) {
            delayMicroseconds((uint32_t)in[CR_NONCE_LEN] * 1000UL);
        }
#endif
        c->setValue(mac, 8);
        c->notify();
    }
};

class ServerCallbacks : public BLEServerCallbacks {
    // Keep broadcasting presence tokens while the anchor is connected
    void onConnect(BLEServer *s) { BLEDevice::startAdvertising(); }
    void onDisconnect(BLEServer *s) { BLEDevice::startAdvertising(); }
};

void updateAdvertisement(uint32_t counter) {
    uint8_t tok[TOKEN_LEN];
    buildToken(counter, tok);

    // Raw AD structures: Flags (3 bytes) + Manufacturer data (2 + 20 bytes)
    uint8_t ad[3 + 2 + TOKEN_LEN];
    ad[0] = 2;    ad[1] = 0x01; ad[2] = 0x06;   // LE General Discoverable, BR/EDR not supported
    ad[3] = 1 + TOKEN_LEN;  ad[4] = 0xFF;        // Manufacturer Specific Data
    memcpy(ad + 5, tok, TOKEN_LEN);

    BLEAdvertisementData advData;
    advData.addData((char *)ad, sizeof(ad));
    pAdvertising->setAdvertisementData(advData);
}

void setup() {
    Serial.begin(115200);
    delay(1000);  // Give serial time to connect

    bootEpoch = nextEpoch();
    epochBaseMs = millis();

    Serial.println("============================");
    Serial.println("  SPAZE Badge v2.0 (PAKL)");
    Serial.println("============================");
    Serial.printf("Badge ID: %u | boot epoch: %u\n", (unsigned)BADGE_ID, (unsigned)bootEpoch);
    Serial.printf("Device Name: %s\n", DEVICE_NAME);
    Serial.println();

    BLEDevice::init(DEVICE_NAME);
    esp_ble_tx_power_set(ESP_BLE_PWR_TYPE_ADV, ESP_PWR_LVL_P3);

    // Challenge-response GATT service (PAKL-CR)
    BLEServer *pServer = BLEDevice::createServer();
    pServer->setCallbacks(new ServerCallbacks());
    BLEService *pService = pServer->createService(CR_SERVICE_UUID);
    pCrChar = pService->createCharacteristic(
        CR_CHAR_UUID,
        BLECharacteristic::PROPERTY_WRITE | BLECharacteristic::PROPERTY_WRITE_NR |
        BLECharacteristic::PROPERTY_NOTIFY);
    pCrChar->addDescriptor(new BLE2902());
    pCrChar->setCallbacks(new CrCallbacks());
    pService->start();

    pAdvertising = BLEDevice::getAdvertising();
    pAdvertising->setMinInterval(ADV_INTERVAL);
    pAdvertising->setMaxInterval(ADV_INTERVAL);

    // Device name goes in the scan response (advertisement holds the token)
    BLEAdvertisementData scanResp;
    scanResp.setName(DEVICE_NAME);
    pAdvertising->setScanResponseData(scanResp);

    lastCounter = currentCounter();
    updateAdvertisement(lastCounter);
    pAdvertising->start();

    Serial.println(">> BLE advertising started (rolling token every 1 s)");
    pinMode(LED_BUILTIN, OUTPUT);
}

void loop() {
    uint32_t nowMs = millis();

    uint32_t counter = currentCounter();
    if (counter != lastCounter) {
        lastCounter = counter;
        updateAdvertisement(counter);
    }

    // Heartbeat blink every 2 s
    if (nowMs - lastBlinkMs >= 2000) {
        lastBlinkMs = nowMs;
        digitalWrite(LED_BUILTIN, HIGH);
        delay(50);
        digitalWrite(LED_BUILTIN, LOW);
    }

    if (nowMs - lastStatusMs >= 10000) {
        lastStatusMs = nowMs;
        Serial.printf("[Badge] uptime %lus | counter %lu\n",
                      (unsigned long)(nowMs / 1000), (unsigned long)counter);
    }

    delay(20);
}
